## CMakeLists.txt
```
# SPDX-License-Identifier: Apache-2.0

cmake_minimum_required(VERSION 3.20.0)
find_package(Zephyr REQUIRED HINTS $ENV{ZEPHYR_BASE})
project(protecli_ups_rp2040)

FILE(GLOB app_sources
    src/*.cpp
)

target_sources(app PRIVATE ${app_sources})
include(${CMAKE_CURRENT_SOURCE_DIR}/../common/CMakeLists.txt)
```

## Kconfig
```
mainmenu "Config for RP2040 UPS Code"

config FORCE_PACK
	bool "Connect battery pack on boot?"
	default y
	help
	  Do you want the battery pack to be connected
	  on boot if 12V input signal is applied?

source "Kconfig.zephyr"
```

## prj.conf
```kconfig
CONFIG_HEAP_MEM_POOL_SIZE=65536

CONFIG_GPIO=y
CONFIG_PWM=y

CONFIG_STDOUT_CONSOLE=y
CONFIG_PRINTK=y
CONFIG_LOG=y
CONFIG_LOG_PRINTK=y
CONFIG_LOG_MODE_IMMEDIATE=y
CONFIG_PWM_LOG_LEVEL_DBG=y
CONFIG_ADC=y

CONFIG_CPP=y
CONFIG_COMMON_LIBC_MALLOC_ARENA_SIZE=4098

CONFIG_CBPRINTF_FP_SUPPORT=y

# Enable all for production firmware
CONFIG_FORCE_PACK=y
```

## rpi_pico.overlay
```dts
/ {
	leds {
		compatible = "gpio-leds";
		led0: led_0 {
			gpios = <&gpio0 17 GPIO_ACTIVE_HIGH>;
			label = "LED";
		};
	};
  };
```

## src/main.cpp
```c
#include <zephyr/kernel.h>
#include <zephyr/drivers/gpio.h>
#include <zephyr/device.h>
#include <zephyr/drivers/pwm.h>
#include <zephyr/drivers/uart.h>
#include <string.h>
#include <stdio.h>

#include "hw_errors.h"
#include "pid.h"
#include "adc.h"
#include "battery.h"

extern "C" {
#include <msg.h>
}

#define PERIOD    PWM_NSEC(2500) // 500Khz
#define STACKSIZE 32768

#define MSG_SIZE 32
K_MSGQ_DEFINE(uart_msgq, MSG_SIZE, 10, 4);

static const struct pwm_dt_spec pwm = PWM_DT_SPEC_GET(DT_ALIAS(pwm_0));

static const struct gpio_dt_spec pwm_en =
	GPIO_DT_SPEC_GET(DT_ALIAS(pwm_en), gpios);

static const struct gpio_dt_spec pwm_skip =
	GPIO_DT_SPEC_GET(DT_ALIAS(pwm_skip), gpios);

static const struct gpio_dt_spec vin_detect =
	GPIO_DT_SPEC_GET(DT_ALIAS(vin_detect), gpios);

static const struct gpio_dt_spec pack_boot =
	GPIO_DT_SPEC_GET(DT_ALIAS(pack_boot), gpios);

static const struct gpio_dt_spec gpio2 =
	GPIO_DT_SPEC_GET(DT_ALIAS(gpio_2), gpios);

static const struct gpio_dt_spec gpio3 =
	GPIO_DT_SPEC_GET(DT_ALIAS(gpio_3), gpios);

static const struct device *const uart_dev =
	DEVICE_DT_GET(DT_CHOSEN(zephyr_mcu_uart));

void print_voltages(Adc adc, float drive)
{
	printk("Vout : %d mV\t", adc.get_vout());
	printk("Vbat : %d mV\t", adc.get_vbat());
	printk("Iout : %d mA\t", adc.get_iout());
	printk("Ibat : %d mA\t", adc.get_ibat());
	printk("Drve : %f\n", drive);
}

/* receive buffer used in UART ISR callback */
static char rx_buf[MSG_SIZE];
static int rx_buf_pos;

/*
 * Read characters from UART until line end is detected. Afterwards push the
 * data to the message queue.
 */
void serial_cb(const struct device *dev, void *user_data)
{
	uint8_t c;

	if (!uart_irq_update(uart_dev)) {
		return;
	}

	if (!uart_irq_rx_ready(uart_dev)) {
		return;
	}

	/* read until FIFO empty */
	while (uart_fifo_read(uart_dev, &c, 1) == 1) {
		if ((c == '\n' || c == '\r') && rx_buf_pos > 0) {
			/* terminate string */
			rx_buf[rx_buf_pos] = '\0';

			/* if queue is full, message is silently dropped */
			k_msgq_put(&uart_msgq, &rx_buf, K_NO_WAIT);

			/* reset the buffer (it was copied to the msgq) */
			rx_buf_pos = 0;
		} else if (rx_buf_pos < (sizeof(rx_buf) - 1)) {
			rx_buf[rx_buf_pos++] = c;
		}
		/* else: characters beyond buffer size are dropped */
	}
}

void print_uart(char *buf, uint8_t msg_len)
{
	for (int i = 0; i < msg_len; i++) {
		uart_poll_out(uart_dev, buf[i]);
	}
}

enum State {
	NONE,
	BUCK,
	BOOST,
	ERROR
} state;

void buckboost(void)
{
	int ret = 0;
	float drive;
	float vout = 0, vbat = 0;
	char uartbuf[64] = {};
	Msg msg = {.vout = 0, .vbat = 0};

	printk("~~~ Protectli UPS ~~~\n");

	HwErrors hw_errors;
	Pid buck_pid(12.0, 0.03, 0.0001, 0.0);

	Battery battery = Battery().setVoltage(16.7).setCurrent(800.0);

	gpio_pin_configure_dt(&pwm_en, GPIO_OUTPUT_INACTIVE);
	gpio_pin_configure_dt(&pack_boot, GPIO_OUTPUT);
	gpio_pin_configure_dt(&pwm_skip, GPIO_OUTPUT_ACTIVE);
	gpio_pin_configure_dt(&vin_detect, GPIO_INPUT);

	gpio_pin_configure_dt(&gpio2, GPIO_DISCONNECTED);
	gpio_pin_configure_dt(&gpio3, GPIO_DISCONNECTED);

	k_sleep(K_MSEC(1000));

	Adc adc;
	print_voltages(adc, 0.00);

	if (!device_is_ready(pwm.dev)) {
		printk("Error: PWM device %s is not ready\n", pwm.dev->name);
	}

	if (!device_is_ready(uart_dev)) {
		printk("UART device not found!");
	}

	/* configure interrupt and callback to receive data */
	uart_irq_callback_user_data_set(uart_dev, serial_cb, NULL);
	uart_irq_rx_enable(uart_dev);

	state = NONE;
	int countdown = 1000;

	while (true) {
		adc.read_all();
		if (!countdown--) {
			hw_errors.check();
			countdown = 1000;
			print_voltages(adc, drive);

			msg.vout = adc.get_vout();
			msg.vbat = adc.get_vbat();
			msg.iout = adc.get_iout();
			msg.ibat = adc.get_ibat();
			msg.gas = (adc.get_vbat() - 12000) / 48;
			ret = msg_cobs_encode(msg, uartbuf);
			print_uart(uartbuf, ret);
		}

		// Buck State
		if (!hw_errors.get() && !gpio_pin_get_dt(&vin_detect)) {
			if (state != BUCK) {
				state = BUCK;
				printk("Entering Buck State\n");
				msg.state = MSG_STATE_DISCHARGING;
			}
			vout = adc.get_vout();
			vout = vout / 1000;
			buck_pid.compute(vout);
			drive = buck_pid.get_duc();

			gpio_pin_set_dt(&pwm_en, true);
			pwm_set_dt(&pwm, PERIOD, PERIOD * drive);
		}
		// Boost State (Charging)
		else if (!hw_errors.get() && gpio_pin_get_dt(&vin_detect)) {
			if (state != BOOST) {
				state = BOOST;
				printk("Entering Boost State\n");
				msg.state = MSG_STATE_CHARGING;
#if defined(CONFIG_FORCE_PACK)
				gpio_pin_set_dt(&pack_boot, true);
				k_sleep(K_MSEC(100U));
				gpio_pin_set_dt(&pack_boot, false);
#endif
			}

			drive = battery.compute_drive(adc.get_vbat(),
						      adc.get_ibat());
			pwm_set_dt(&pwm, PERIOD, PERIOD * drive);
			gpio_pin_set_dt(&pwm_en, true);
		}
		// Error State
		else {
			if (state != ERROR) {
				state = ERROR;
				msg.state = MSG_STATE_ERROR;
				printk("UPS In Error State: %d\n",
				       hw_errors.get());
			}
			gpio_pin_set_dt(&pwm_en, false);
			pwm_set_dt(&pwm, PERIOD, 0);
			k_sleep(K_SECONDS(5U));
			state = NONE;
		}
	}
}

K_THREAD_DEFINE(buckboost_id, STACKSIZE, buckboost, NULL, NULL, NULL, 0, 0, 0);
```

## src/adc.cpp
```c
#include "adc.h"

#if !DT_NODE_EXISTS(DT_PATH(zephyr_user)) ||                                   \
	!DT_NODE_HAS_PROP(DT_PATH(zephyr_user), io_channels)
#error "No suitable devicetree overlay specified"
#endif

#define DT_SPEC_AND_COMMA(node_id, prop, idx)                                  \
	ADC_DT_SPEC_GET_BY_IDX(node_id, idx),

static uint16_t buf;

/* Data of ADC io-channels specified in devicetree. */
static const struct adc_dt_spec adc_channels[] = {DT_FOREACH_PROP_ELEM(
	DT_PATH(zephyr_user), io_channels, DT_SPEC_AND_COMMA)};

Adc::Adc()
	: num_chan(ARRAY_SIZE(adc_channels)), vout(0), vbat(0), iout(0), ibat(0)
{
	int err;

	sequence = {
		.buffer = &buf,
		/* buffer size in bytes, not number of samples */
		.buffer_size = sizeof(buf),
	};

	/* Configure channels individually prior to sampling. */
	for (size_t i = 0U; i < ARRAY_SIZE(adc_channels); i++) {
		if (!device_is_ready(adc_channels[i].dev)) {
			printk("ADC controller device %s not ready\n",
			       adc_channels[i].dev->name);
		}

		err = adc_channel_setup_dt(&adc_channels[i]);
		if (err < 0) {
			printk("Could not setup channel #%d (%d)\n", i, err);
		}
	}
}

bool Adc::check_chan(size_t ch)
{
	if (ch > num_chan) {
		printk("Channel out of range!");
		return false;
	}
	return true;
}

int Adc::read(size_t i)
{
	int err;
	int32_t val_mv;

	if (!check_chan(i)) {
		return -1;
	}

	(void)adc_sequence_init_dt(&adc_channels[i], &sequence);
	err = adc_read(adc_channels[i].dev, &sequence);

	if (err < 0) {
		printk("Could not read (%d)\n", err);
		return -1;
	}

	if (adc_channels[i].channel_cfg.differential) {
		val_mv = (int32_t)((int16_t)buf);
	} else {
		val_mv = (int32_t)buf;
	}

	err = adc_raw_to_millivolts_dt(&adc_channels[i], &val_mv);

	return val_mv;
}

int Adc::sample_vout()
{
	// (R4 + R6) / R6
	// (1e6 + 240e3) / 240e3 = 5.1666
	vout = read(0) * 5.1666;
	return vout;
}

int Adc::sample_vbat()
{
	// (R7 + R8) / R8
	// (100e3 + 7.32e3) / 7.32e3 = 14.6612
	vbat = read(1) * 14.6612;
	return vbat;
}

int Adc::sample_iout()
{
	// I = ((V / R5) / U5_Gain)
	iout = (read(2) / 5e-3) / 20;
	return iout;
}

int Adc::sample_ibat()
{
	// I = ((V / R2) / U21_Gain)
	ibat = (read(3) / 5e-3) / 200;
	return ibat;
}

void Adc::read_all()
{
	sample_vout();
	sample_vbat();
	sample_iout();
	sample_ibat();
}
```

## src/adc.h
```c
#include <zephyr/drivers/adc.h>

class Adc
{
	uint8_t num_chan;
	struct adc_sequence sequence;
	int vout, vbat, iout, ibat;

	bool check_chan(size_t ch);
	int read(size_t chan);

      public:
	Adc();

	int sample_vout();
	int sample_vbat();
	int sample_iout();
	int sample_ibat();

	void read_all();
	int get_vout()
	{
		return vout;
	};
	int get_vbat()
	{
		return vbat;
	};
	int get_iout()
	{
		return iout;
	};
	int get_ibat()
	{
		return ibat;
	};
};
```

## src/battery.cpp
```c
#include <string.h>
#include "battery.h"

Battery::Battery()
	: bump_amt(0.000001), initial_drive(0.780), drive(initial_drive)
{
}

float Battery::compute_drive(float v, float i)
{

	if (i < target_i && v < target_v) {
		drive -= bump_amt; // This adds current
	} else {
		drive += bump_amt;
	}

	if (drive >= 0.85) {
		drive = 0.85;
	}

	// If the drive have dipped below this amount, something has happened.
	if (drive <= 0.65) {
		drive = initial_drive;
	}

	return drive;
}
```

## src/battery.h
```c
#include <zephyr/kernel.h>

class Battery
{
	int target_v;   // mV
	float target_i; // mA
	float bump_amt;
	float initial_drive;
	float drive;

      public:
	Battery();
	float compute_drive(float v, float i);

	Battery &setVoltage(float v)
	{
		target_v = v * 1000;
		return *this;
	}

	Battery &setCurrent(float i)
	{
		target_i = i;
		return *this;
	}
};
```

## src/buck.cpp
```c
#include "buck.h"

buck::buck(float vset, float vmax, pid pid)
:v_set(v_set), pd(pid)
{
    pd->set();

}
```

## src/buck.h
```c
#include "pid.h"

class buck {
    float v_set;
    pid *pd;

public:
    buck(float v_set);
    void update_voltage(float v);

};
```

## src/hw_errors.cpp
```c
#include <string.h>
#include <zephyr/kernel.h>
#include <zephyr/drivers/gpio.h>
#include "hw_errors.h"

/* LEDs */
static const struct gpio_dt_spec load_oc_led =
	GPIO_DT_SPEC_GET(DT_ALIAS(load_overcurrent_led), gpios);

static const struct gpio_dt_spec batt_oc_led =
	GPIO_DT_SPEC_GET(DT_ALIAS(batt_overcurrent_led), gpios);

static const struct gpio_dt_spec batt_ov_led =
	GPIO_DT_SPEC_GET(DT_ALIAS(batt_overvoltage_led), gpios);

/* Input Signals from HW */
static const struct gpio_dt_spec load_oc =
	GPIO_DT_SPEC_GET(DT_NODELABEL(load_overcurrent), gpios);

static const struct gpio_dt_spec batt_oc =
	GPIO_DT_SPEC_GET(DT_NODELABEL(batt_overcurrent), gpios);

static const struct gpio_dt_spec batt_ov =
	GPIO_DT_SPEC_GET(DT_NODELABEL(batt_overvoltage), gpios);

HwErrors::HwErrors() : last_error_code(0), error_code(0)
{
	gpio_pin_configure_dt(&load_oc_led, GPIO_OUTPUT_INACTIVE);
	gpio_pin_configure_dt(&batt_oc_led, GPIO_OUTPUT_INACTIVE);
	gpio_pin_configure_dt(&batt_ov_led, GPIO_OUTPUT_INACTIVE);

	gpio_pin_configure_dt(&load_oc, GPIO_INPUT);
	gpio_pin_configure_dt(&batt_oc, GPIO_INPUT);
	gpio_pin_configure_dt(&batt_ov, GPIO_INPUT);
}

uint8_t HwErrors::check(void)
{
	memset(&errorCodes, 0x00, sizeof(errorCodes));
	error_code = 0x00;

	/* Load Overcurrent */
	if (gpio_pin_get_dt(&load_oc)) {
		printk("Load Overcurrent! \n");
		errorCodes.load_oc = true;
		gpio_pin_set_dt(&load_oc_led, errorCodes.load_oc);
		error_code |= 1;
	}

	/* Battery Overcurrent */
	if (gpio_pin_get_dt(&batt_oc)) {
		printk("Battery Overcurrent! \n");
		errorCodes.batt_oc = true;
		gpio_pin_set_dt(&batt_oc_led, errorCodes.batt_oc);
		error_code |= 2;
	}

	/* Battery Overvoltage */
	if (gpio_pin_get_dt(&batt_ov)) {
		printk("Battery Overvoltage! \n");
		errorCodes.batt_ov = true;
		gpio_pin_set_dt(&batt_ov_led, errorCodes.batt_ov);
		error_code |= 4;
	}

	if (last_error_code != error_code) {
		printk("New Errorlevel: %d\n", error_code);
	}

	last_error_code = error_code;

	return error_code;
}
```

## src/hw_errors.h
```c
class HwErrors
{
	struct {
		bool load_oc;
		bool batt_oc;
		bool batt_ov;
	} errorCodes;

	uint8_t error_code;
	uint8_t last_error_code;

      public:
	HwErrors();
	uint8_t check();
	uint8_t get()
	{
		return error_code;
	}
};
```

## src/pid.cpp
```c
#include <zephyr/kernel.h>
#include "pid.h"

Pid::Pid(float target, float kp, float ki, float kd)
	: target(target), kp(kp), ki(ki), kd(kd), e_sum(0)
{
	compute(target);
}

float Pid::get_i_term(void)
{
	return e_sum;
}

void Pid::zero_i_term(void)
{
	e_sum = 0;
}

float Pid::compute(float actual)
{
	uint32_t t = k_cycle_get_32();
	float e = target - actual;
	float dt = (t - t_prev) / 125e6;
	float de = e - e_prev;
	float derivatave = (e - e_prev) / dt;
	e_sum += e;

	if (e_sum < INTEGRATOR_WINDUP_NEG) {
		e_sum = INTEGRATOR_WINDUP_NEG;
	}

	drive = (e * kp) + (e_sum * ki) + (derivatave * kd);

	if (drive >= 0.90) {
		drive = 0.90;
	}

	if (drive <= 0.02) {
		drive = 0.02;
	}

	e_prev = e;
	t_prev = t;
	return drive;
}
```

## src/pid.h
```c
#define MAX_DRIVE             1.0
#define INTEGRATOR_WINDUP_NEG (-100)
#define INTEGRATOR_WINDUP_POS (1000000)

class Pid
{
	float target;
	float kp, ki, kd;
	float e_prev, e_sum;
	float t, t_prev;
	float drive;

      protected:
	void update_target();

      public:
	Pid(float target, float kp, float ki, float kd);
	float compute(float actual);
	float compute_boost(float actual);
	float get_i_term(void);
	void zero_i_term(void);

	void update_target(float t)
	{
		target = t;
	}

	float get_duc()
	{
		return drive;
	}
};
```

## CMakeLists.txt
```
# SPDX-License-Identifier: Apache-2.0

cmake_minimum_required(VERSION 3.20.0)
find_package(Zephyr REQUIRED HINTS $ENV{ZEPHYR_BASE})
project(protecli_ups_esp32)

FILE(GLOB app_sources
    src/*.c
)

target_sources(app PRIVATE ${app_sources})
# target_link_libraries(app PRIVATE common)
```

## prj.conf
```kconfig
CONFIG_GPIO=y
CONFIG_LOG=y

CONFIG_DISPLAY=y
CONFIG_CFB_LOG_LEVEL_DBG=y
CONFIG_CHARACTER_FRAMEBUFFER=y
# CONFIG_CHARACTER_FRAMEBUFFER_ROTATE=y

CONFIG_STDOUT_CONSOLE=y
CONFIG_PRINTK=y

CONFIG_SPI=y

CONFIG_SERIAL=y
CONFIG_UART_INTERRUPT_DRIVEN=y

CONFIG_FPU=y
CONFIG_NEWLIB_LIBC=y
CONFIG_NEWLIB_LIBC_FLOAT_PRINTF=y
CONFIG_NEWLIB_LIBC_FLOAT_SCANF=y
```

## esp32.overlay
```dts
/ {
    aliases {
        led0 = &myled0;
    };

    leds {
        compatible = "gpio-leds";
        myled0: led_0 {
            gpios = <&gpio0 16 GPIO_ACTIVE_LOW>;
               };
    };
  };
```

## src/main.c
```c
#include <stdio.h>
#include <zephyr/drivers/gpio.h>
#include <zephyr/drivers/spi.h>
#include <zephyr/drivers/uart.h>
#include <zephyr/kernel.h>

#include "msg.h"
#include "screen.h"

#define SLEEP_TIME_MS 5000
#define LED0_NODE     DT_ALIAS(led0)

#define MSG_SIZE 32

K_MSGQ_DEFINE(uart_msgq, MSG_SIZE, 10, 4);

static struct k_poll_signal spi_slave_done_sig =
	K_POLL_SIGNAL_INITIALIZER(spi_slave_done_sig);

static const struct gpio_dt_spec led =
	GPIO_DT_SPEC_GET(DT_NODELABEL(led0), gpios);

static const struct gpio_dt_spec relay1 =
	GPIO_DT_SPEC_GET(DT_NODELABEL(relay1), gpios);

static const struct gpio_dt_spec relay2 =
	GPIO_DT_SPEC_GET(DT_NODELABEL(relay2), gpios);

static const struct device *const uart_dev =
	DEVICE_DT_GET(DT_CHOSEN(zephyr_mcu_uart));

/* receive buffer used in UART ISR callback */
static char rx_buf[MSG_SIZE];
static int rx_buf_pos = 0;

struct k_msgq msgq;
char msgq_buffer[sizeof(struct Msg) * 2];

K_THREAD_STACK_DEFINE(screen_thd_stack_area, SCREEN_THD_STACK_SIZE);
struct k_thread screen_thd_data;

/*
 * Read characters from UART until line end is detected. Afterwards push the
 * data to the message queue.
 */
void serial_cb(const struct device *dev, void *user_data)
{
	uint8_t c;

	if (!uart_irq_update(uart_dev)) {
		return;
	}

	if (!uart_irq_rx_ready(uart_dev)) {
		return;
	}

	while (uart_fifo_read(uart_dev, &c, 1) == 1) {
		if (!c && rx_buf_pos > sizeof(struct Msg)) {
			// We have a complete packet
			struct Msg msg = {};
			msg_cobs_decode(rx_buf, &msg);
			while (k_msgq_put(&msgq, &msg, K_NO_WAIT) != 0) {
				k_msgq_purge(&msgq);
			}
			rx_buf_pos = 0;
		} else if (c) {
			rx_buf[rx_buf_pos++] = c;
		}
	}
}

void print_uart(char *buf)
{
	int msg_len = strlen(buf);

	for (int i = 0; i < msg_len; i++) {
		uart_poll_out(uart_dev, buf[i]);
	}
}

int main(void)
{
	int ret;
	char tx_buf[MSG_SIZE];

	printf("Starting Up!\n");

	if (!gpio_is_ready_dt(&led)) {
		return 0;
	}

	k_msgq_init(&msgq, msgq_buffer, sizeof(struct Msg), 2);

	gpio_pin_configure_dt(&led, GPIO_OUTPUT_INACTIVE);
	gpio_pin_configure_dt(&relay1, GPIO_OUTPUT_ACTIVE);

	if (!device_is_ready(uart_dev)) {
		printk("UART device not found!");
		return 0;
	}

	screen_init();

	/* configure interrupt and callback to receive data */
	ret = uart_irq_callback_user_data_set(uart_dev, serial_cb, NULL);
	uart_irq_rx_enable(uart_dev);

	k_tid_t my_tid = k_thread_create(
		&screen_thd_data, screen_thd_stack_area,
		K_THREAD_STACK_SIZEOF(screen_thd_stack_area), screen_thread,
		NULL, NULL, NULL, SCREEN_THD_PRIORITY, 0, K_NO_WAIT);

	while (1) {
		gpio_pin_toggle_dt(&led);
		k_sleep(K_MSEC(100U));
	}
	return 0;
}
```

## src/fw_version.h
```c
#define FW_SUBVERSION 1
#define FW_VERSION    0
```

## src/screen.c
```c
#include <zephyr/kernel.h>
#include <zephyr/drivers/display.h>
#include <zephyr/display/cfb.h>

#include "screen.h"
#include "protectli_logo.h"
#include "fw_version.h"
#include "msg.h"

#include <string.h>
#include <stdio.h>

const struct device *display;
char buf[256] = {};
extern struct k_msgq msgq;

int screen_init(void)
{
	uint16_t rows;
	uint8_t ppt;
	uint8_t font_width;
	uint8_t font_height;

	display = DEVICE_DT_GET(DT_CHOSEN(zephyr_display));

	if (!device_is_ready(display)) {
		printk("Device %s not ready\n", display->name);
		return 0;
	}

	if (display_set_pixel_format(display, PIXEL_FORMAT_MONO10) != 0) {
		printk("Failed to set required pixel format\n");
		return 0;
	}

	if (cfb_framebuffer_init(display)) {
		printk("Framebuffer initialization failed!\n");
		return 0;
	}

	display_blanking_off(display);
	rows = cfb_get_display_parameter(display, CFB_DISPLAY_ROWS);
	ppt = cfb_get_display_parameter(display, CFB_DISPLAY_PPT);

	for (int idx = 0; idx < 42; idx++) {
		if (cfb_get_font_size(display, idx, &font_width,
				      &font_height)) {
			break;
		}
		if (font_height == 16) {
			cfb_framebuffer_set_font(display, idx);
		}

		printk("font width %d, font height %d\n", font_width,
		       font_height);
	}

	printk("x_res %d, y_res %d, ppt %d, rows %d, cols %d\n",
	       cfb_get_display_parameter(display, CFB_DISPLAY_WIDTH),
	       cfb_get_display_parameter(display, CFB_DISPLAY_HEIGH), ppt, rows,
	       cfb_get_display_parameter(display, CFB_DISPLAY_COLS));

	cfb_framebuffer_invert(display);
	return 0;
}

void screen_draw_battery()
{
	struct cfb_position p1, p2;
	p1.x = 98;
	p1.y = 50;
	p2.x = 120;
	p2.y = 60;
	cfb_draw_rect(display, &p1, &p2);
	p1.x = 121;
	p1.y = 52;
	p2.x = 124;
	p2.y = 58;
	cfb_draw_rect(display, &p1, &p2);
}

// Capacity 0 -> 100
void screen_fill_battery(int capacity)
{
	struct cfb_position p1, p2;
	capacity = capacity * 0.22;
	p1.y = 50;
	p2.y = 60;
	for (int i = 0; i <= 22; i++) {
		if (capacity > i) {
			p1.x = 98 + i;
			p2.x = 98 + i;
			cfb_draw_line(display, &p1, &p2);
		}
	}
}

void screen_draw_intro()
{
	memset(buf, 0x00, sizeof(buf));
	cfb_framebuffer_clear(display, true);

	draw_logo(display);
	sprintf(buf, "R1 FW: %d.%d", FW_VERSION, FW_SUBVERSION);
	cfb_draw_text(display, buf, 0, 50);

	cfb_framebuffer_finalize(display);
}

void screen_draw_error()
{
	memset(buf, 0x00, sizeof(buf));
	cfb_framebuffer_clear(display, true);

	sprintf(buf, "Error! No msg");
	cfb_draw_text(display, buf, 0, 0);
	sprintf(buf, "from RP2040!");
	cfb_draw_text(display, buf, 0, 20);

	cfb_framebuffer_finalize(display);
}
void screen_draw_banner(struct Msg msg)
{
	memset(buf, 0x00, sizeof(buf));

	screen_draw_battery();
	screen_fill_battery(msg.gas);
	if (msg.state == MSG_STATE_CHARGING) {
		sprintf(buf, "Char");
	} else {
		sprintf(buf, "Dischar");
	}
	cfb_draw_text(display, buf, 0, 46);
}

void screen_draw_vout(struct Msg msg)
{
	memset(buf, 0x00, sizeof(buf));
	cfb_framebuffer_clear(display, true);

	sprintf(buf, "Vout: %.2fV", (float)msg.vout / 1000);
	cfb_draw_text(display, buf, 0, 0);
	sprintf(buf, "Idis: %.1fA", (float)msg.iout / 1000);
	cfb_draw_text(display, buf, 0, 20);
	screen_draw_banner(msg);

	cfb_framebuffer_finalize(display);
}

void screen_draw_vbat(struct Msg msg)
{
	memset(buf, 0x00, sizeof(buf));
	cfb_framebuffer_clear(display, true);

	sprintf(buf, "Vbat: %.2fV", (float)msg.vbat / 1000);
	cfb_draw_text(display, buf, 0, 0);
	sprintf(buf, "Ichg: %.1fA", (float)msg.ibat / 1000);
	cfb_draw_text(display, buf, 0, 20);
	screen_draw_banner(msg);

	cfb_framebuffer_finalize(display);
}

void screen_thread(void *, void *, void *)
{
	int ret = 0;
	enum screen_state state = INTRO;
	screen_draw_intro();
	k_sleep(K_MSEC(5000U));
	state = VBAT;

	while (true) {
		struct Msg msg = {};
		ret = k_msgq_get(&msgq, &msg, K_MSEC(1000));

		if (ret != 0) {
			screen_draw_error();
			k_sleep(K_MSEC(5000U));
		} else if (state == VBAT) {
			screen_draw_vbat(msg);
			k_sleep(K_MSEC(3000U));
			state = VOUT;
		} else if (state == VOUT) {
			screen_draw_vout(msg);
			k_sleep(K_MSEC(3000U));
			state = VBAT;
		}
	}
}
```

## src/screen.h
```c
#define SCREEN_THD_STACK_SIZE 500
#define SCREEN_THD_PRIORITY   5

void screen_thread(void *, void *, void *);
int screen_init(void);

enum screen_state {
	INTRO,
	ERR,
	VBAT,
	VOUT
};
```

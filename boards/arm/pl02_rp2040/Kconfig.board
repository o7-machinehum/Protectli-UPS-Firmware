## boards/arm/pl02_rp2040/Kconfig.board
```kconfig
# Copyright (c) 2021 Yonatan Schachter
# SPDX-License-Identifier: Apache-2.0

config BOARD_PL02_RP2040
	bool "Raspberry Pi Pico Board"
	depends on SOC_RP2040
```

## boards/arm/pl02_rp2040/Kconfig.defconfig
```kconfig
# Copyright (c) 2021 Yonatan Schachter
# SPDX-License-Identifier: Apache-2.0

if BOARD_PL02_RP2040

config BOARD
	default "pl02_rp2040" if BOARD_PL02_RP2040

config RP2_FLASH_W25Q080
	default y

if I2C_DW

config I2C_DW_CLOCK_SPEED
	default 125

endif #I2C_DW

config USB_SELF_POWERED
	default n

endif # BOARD_PL02_RP2040
```

## west.yml
```yaml
# Copyright (c) 2021 Nordic Semiconductor ASA
# SPDX-License-Identifier: Apache-2.0

manifest:
  self:
    west-commands: scripts/west-commands.yml

  remotes:
    - name: zephyrproject-rtos
      url-base: https://github.com/zephyrproject-rtos

    - name: zephyrproject-rtos-walker
      url-base: https://github.com/o7-machinehum

  projects:
    - name: zephyr
      remote: zephyrproject-rtos-walker
      revision: cfb-rotate
      import:
        # By using name-allowlist we can clone only the modules that are
        # strictly needed by the application.
        name-allowlist:
          - cmsis         # required by the ARM port
          - hal_espressif
          - hal_rpi_pico
```
